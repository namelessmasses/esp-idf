## examples/peripherals/lcd/i2c_oled/sdkconfig.defaults
```kconfig
CONFIG_BOOTLOADER_COMPILE_TIME_DATE=y
CONFIG_BOOTLOADER_PROJECT_VER=0
CONFIG_BOOTLOADER_PROJECT_VER_FROM_BUILD_TIMESTAMP=y

#
# Log
#
# default:
CONFIG_BOOTLOADER_LOG_VERSION_2=y
# default:
CONFIG_BOOTLOADER_LOG_VERSION=2
# CONFIG_BOOTLOADER_LOG_LEVEL_NONE is not set
# CONFIG_BOOTLOADER_LOG_LEVEL_ERROR is not set
# CONFIG_BOOTLOADER_LOG_LEVEL_WARN is not set
# CONFIG_BOOTLOADER_LOG_LEVEL_INFO is not set
CONFIG_BOOTLOADER_LOG_LEVEL_DEBUG=y
# CONFIG_BOOTLOADER_LOG_LEVEL_VERBOSE is not set
# default:
CONFIG_BOOTLOADER_LOG_LEVEL=4

#
# Format
#
CONFIG_BOOTLOADER_LOG_COLORS=y
# default:
CONFIG_BOOTLOADER_LOG_COLORS_SUPPORT=y
# default:
# CONFIG_BOOTLOADER_LOG_TIMESTAMP_SOURCE_NONE is not set
# default:
CONFIG_BOOTLOADER_LOG_TIMESTAMP_SOURCE_CPU_TICKS=y
# default:
CONFIG_BOOTLOADER_LOG_TIMESTAMP_SUPPORT=y
# end of Format

#
# Settings
#
# default:
CONFIG_BOOTLOADER_LOG_MODE_TEXT_EN=y
# default:
CONFIG_BOOTLOADER_LOG_MODE_TEXT=y

#
# Log
#
# CONFIG_LOG_VERSION_1 is not set
CONFIG_LOG_VERSION_2=y
# default:
CONFIG_LOG_VERSION=2

#
# Log Level
#
# default:
# CONFIG_LOG_DEFAULT_LEVEL_NONE is not set
# default:
# CONFIG_LOG_DEFAULT_LEVEL_ERROR is not set
# default:
# CONFIG_LOG_DEFAULT_LEVEL_WARN is not set
# default:
CONFIG_LOG_DEFAULT_LEVEL_INFO=y
# default:
# CONFIG_LOG_DEFAULT_LEVEL_DEBUG is not set
# default:
# CONFIG_LOG_DEFAULT_LEVEL_VERBOSE is not set
# default:
CONFIG_LOG_DEFAULT_LEVEL=3
# CONFIG_LOG_MAXIMUM_EQUALS_DEFAULT is not set
# CONFIG_LOG_MAXIMUM_LEVEL_DEBUG is not set
CONFIG_LOG_MAXIMUM_LEVEL_VERBOSE=y
# default:
CONFIG_LOG_MAXIMUM_LEVEL=5

#
# Level Settings
#
# default:
# CONFIG_LOG_MASTER_LEVEL is not set
# default:
CONFIG_LOG_DYNAMIC_LEVEL_CONTROL=y
# default:
# CONFIG_LOG_TAG_LEVEL_IMPL_NONE is not set
# default:
# CONFIG_LOG_TAG_LEVEL_IMPL_LINKED_LIST is not set
# default:
CONFIG_LOG_TAG_LEVEL_IMPL_CACHE_AND_LINKED_LIST=y
# default:
# CONFIG_LOG_TAG_LEVEL_CACHE_ARRAY is not set
# default:
CONFIG_LOG_TAG_LEVEL_CACHE_BINARY_MIN_HEAP=y
# default:
CONFIG_LOG_TAG_LEVEL_IMPL_CACHE_SIZE=31
# end of Level Settings
# end of Log Level

#
# Format
#
CONFIG_LOG_COLORS=y
CONFIG_LOG_COLORS_SUPPORT=y
# CONFIG_LOG_TIMESTAMP_SOURCE_NONE is not set
# CONFIG_LOG_TIMESTAMP_SOURCE_RTOS is not set
# CONFIG_LOG_TIMESTAMP_SOURCE_SYSTEM is not set
CONFIG_LOG_TIMESTAMP_SOURCE_SYSTEM_FULL=y
# CONFIG_LOG_TIMESTAMP_SOURCE_UNIX is not set
# default:
CONFIG_LOG_TIMESTAMP_SUPPORT=y
# end of Format

#
# Settings
#
# default:
CONFIG_LOG_MODE_TEXT_EN=y
# default:
CONFIG_LOG_MODE_TEXT=y
# default:
# CONFIG_LOG_MODE_BINARY is not set
# end of Settings

# default:
CONFIG_LOG_API_CONSTRAINED_ENV_SAFE=y
# default:
CONFIG_LOG_IN_IRAM=y
# end of Log

CONFIG_APP_COMPILE_TIME_DATE=y
CONFIG_ESPTOOLPY_HEADER_FLASHSIZE_UPDATE=y
CONFIG_PARTITION_TABLE_SINGLE_APP_LARGE=y
CONFIG_PARTITION_TABLE_OFFSET=0x9000
CONFIG_COMPILER_CXX_EXCEPTIONS=y
CONFIG_COMPILER_CXX_EXCEPTIONS_EMG_POOL_SIZE=0
CONFIG_COMPILER_CXX_RTTI=y
CONFIG_LV_FONT_UNSCII_8=y
CONFIG_LV_FONT_UNSCII_16=y
CONFIG_LV_FONT_DEFAULT_UNSCII_8=y

CONFIG_SPI_FLASH_SUPPORT_BOYA_CHIP=y
```

## examples/peripherals/lcd/i2c_oled/test/sdkconfig.defaults
```kconfig
CONFIG_ESP_TASK_WDT_EN=n
CONFIG_SPI_FLASH_SUPPORT_BOYA_CHIP=y
#CONFIG_ESP_GDBSTUB_ENABLED=y
#CONFIG_ESP_SYSTEM_GDBSTUB_RUNTIME=y
#CONFIG_ESP_GDBSTUB_SUPPORT_TASKS=y
#CONFIG_ESP_GDBSTUB_MAX_TASKS=32
CONFIG_COMPILER_CXX_EXCEPTIONS=y
CONFIG_COMPILER_CXX_RTTI=y
```
